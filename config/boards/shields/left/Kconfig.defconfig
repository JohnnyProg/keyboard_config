## config/boards/shields/left/Kconfig.defconfig
```kconfig
if SHIELD_VESTERA_LEFT

config ZMK_KEYBOARD_NAME
  default "vestera_left"

endif
```

## config/boards/shields/right/Kconfig.defconfig
```kconfig
if SHIELD_VESTERA_RIGHT

config ZMK_KEYBOARD_NAME
  default "vestera_right"

endif
```
